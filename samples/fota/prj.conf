## CMakeLists.txt
```
cmake_minimum_required(VERSION 3.13.1)

find_package(Zephyr REQUIRED HINTS $ENV{ZEPHYR_BASE})

# Add custom signing key to the bootloader (mcuboot) config
set(mcuboot_CONF_FILE
  ${CMAKE_CURRENT_SOURCE_DIR}/../../deps/bootloader/mcuboot/boot/zephyr/prj.conf
  ${CMAKE_CURRENT_SOURCE_DIR}/mcuboot.conf
)

project(lab5e_fota)

target_sources(app PRIVATE src/main.c)
target_sources(app PRIVATE src/fota.c)
zephyr_include_directories(src)
```

## prj.conf
```kconfig
# General config
CONFIG_ASSERT=y

# LTE link control
CONFIG_LTE_LINK_CONTROL=y
CONFIG_LTE_AUTO_INIT_AND_CONNECT=y
CONFIG_LTE_PDP_CMD=y
CONFIG_LTE_PDP_CONTEXT="0,\"IP\",\"mda.lab5e\""

# Heap and stacks
CONFIG_HEAP_MEM_POOL_SIZE=16384
CONFIG_MAIN_STACK_SIZE=8192
CONFIG_SYSTEM_WORKQUEUE_STACK_SIZE=2048
CONFIG_HW_STACK_PROTECTION=y

# Disable native network stack to save some memory
CONFIG_NET_IPV4=n
CONFIG_NET_IPV6=n
CONFIG_NET_UDP=n
CONFIG_NET_TCP=n
CONFIG_NET_RX_STACK_SIZE=1024
CONFIG_NET_TX_STACK_SIZE=1024

# Uncomment the lines below to disable optimizations when debugging
# CONFIG_NO_OPTIMIZATIONS=y
# CONFIG_DEBUG=y


## All of the following options are necessary for FOTA:

CONFIG_APP_FIRMWARE_VERSION="1.0.0"

# Logging
CONFIG_LOG=y
CONFIG_LOG_STRDUP_MAX_STRING=64

# General config
CONFIG_REBOOT=y

# Network
CONFIG_NETWORKING=y

# BSD library
CONFIG_BSD_LIBRARY=y

# LTE link control
CONFIG_LTE_LINK_CONTROL=y

# Modem info
CONFIG_MODEM_INFO=y

# Extend CoAP retry timing to 10 seconds for LTE/LTE-M.
CONFIG_COAP_INIT_ACK_TIMEOUT_MS=10000

# The LwM2M RD server we use returns long options, specifically the client registration endpoint (== IMSI).
CONFIG_COAP_EXTENDED_OPTIONS_LEN=y
CONFIG_COAP_EXTENDED_OPTIONS_LEN_VALUE=32

# LwM2M
CONFIG_LWM2M=y
CONFIG_LWM2M_RW_JSON_SUPPORT=n
CONFIG_LWM2M_ENGINE_DEFAULT_LIFETIME=600
CONFIG_LWM2M_FIRMWARE_UPDATE_OBJ_SUPPORT=y
CONFIG_LWM2M_FIRMWARE_UPDATE_PULL_SUPPORT=y

# Firmware image
CONFIG_BOOTLOADER_MCUBOOT=y
CONFIG_IMG_MANAGER=y
CONFIG_MCUBOOT_IMG_MANAGER=y
CONFIG_IMG_ERASE_PROGRESSIVELY=y
CONFIG_FLASH=y
CONFIG_MPU_ALLOW_FLASH_WRITE=y
CONFIG_DFU_TARGET=y

# Add signing key relative to mcuboot folder
CONFIG_BOOT_SIGNATURE_KEY_FILE="../../../samples/fota/cert.pem"

## End FOTA options.
```

## src/main.c
```c
/*
	Copyright [2019] [Exploratory Engineering]
	Modifications Copyright [2021] [Lab5e AS]

   Licensed under the Apache License, Version 2.0 (the "License");
   you may not use this file except in compliance with the License.
   You may obtain a copy of the License at

       http://www.apache.org/licenses/LICENSE-2.0

   Unless required by applicable law or agreed to in writing, software
   distributed under the License is distributed on an "AS IS" BASIS,
   WITHOUT WARRANTIES OR CONDITIONS OF ANY KIND, either express or implied.
   See the License for the specific language governing permissions and
   limitations under the License.#include <zephyr.h>
*/   


#include <zephyr.h>
#include <logging/log.h>

#include "fota.h"

LOG_MODULE_REGISTER(app_main, CONFIG_APP_LOG_LEVEL);

void main() {
	fota_client_info client_info = {
		manufacturer: "Exploratory Engineering",
		model_number: "EE-FOTA-00",
		serial_number: "1",
		firmware_version: CONFIG_APP_FIRMWARE_VERSION,
	};

	// Initialize the application and run any self-tests before calling fota_init.
	// Otherwise, if initialization or self-tests fail after an update, reboot the system and the previous firmware image will be used.

	int ret = fota_init(client_info);
	if (ret) {
		LOG_ERR("fota_init: %d", ret);
		return;
	}
}
```

## src/fota.c
```c
/*
	Copyright [2019] [Exploratory Engineering]
	Modifications Copyright [2021] [Lab5e AS]

   Licensed under the Apache License, Version 2.0 (the "License");
   you may not use this file except in compliance with the License.
   You may obtain a copy of the License at

       http://www.apache.org/licenses/LICENSE-2.0

   Unless required by applicable law or agreed to in writing, software
   distributed under the License is distributed on an "AS IS" BASIS,
   WITHOUT WARRANTIES OR CONDITIONS OF ANY KIND, either express or implied.
   See the License for the specific language governing permissions and
   limitations under the License.#include <zephyr.h>
*/   

#include <zephyr.h>
#include <logging/log.h>
#include <dfu/mcuboot.h>
#include <dfu/dfu_target.h>
#include <power/reboot.h>
#include <modem/modem_info.h>
#include <modem/nrf_modem_lib.h>
#include <net/lwm2m.h>
#include <stdio.h>
#include <nrf_modem.h>

#include "fota.h"

LOG_MODULE_REGISTER(app_fota, CONFIG_APP_LOG_LEVEL);

#include "pm_config.h"
#define FLASH_AREA_IMAGE_SECONDARY PM_MCUBOOT_SECONDARY_ID
#define FLASH_BANK_SIZE            PM_MCUBOOT_SECONDARY_SIZE

static int check_modem_firmware_update() {
	// Modem firmware updates require a second reboot.
	int err = nrf_modem_lib_init(NORMAL_MODE);

	switch (err) {
	case MODEM_DFU_RESULT_OK:
		LOG_INF("Modem firmware update successful!");
		LOG_INF("Modem will run the new firmware after reboot");
		sys_reboot(0);
		break;
	case MODEM_DFU_RESULT_UUID_ERROR:
	case MODEM_DFU_RESULT_AUTH_ERROR:
		LOG_ERR("Modem firmware update failed");
		LOG_ERR("Modem will run non-updated firmware after reboot.");
		sys_reboot(0);
		break;
	case MODEM_DFU_RESULT_HARDWARE_ERROR:
	case MODEM_DFU_RESULT_INTERNAL_ERROR:
		LOG_ERR("Modem firmware update failed: %d", err);
		return err;
	}
	return 0;
}

static struct k_delayed_work reboot_work;

static void do_reboot(struct k_work *work) {
	int ret = boot_request_upgrade(BOOT_UPGRADE_TEST);
	if (ret) {
		LOG_ERR("boot_request_upgrade: %d", ret);
	}

	sys_reboot(0);
}

static int firmware_update_cb(uint16_t obj_inst_id, uint8_t * args, uint16_t args_len) {
	LOG_INF("Executing firmware update");

	// Wait a few seconds before rebooting so that the lwm2m client has a chance
	// to acknowledge having received the Update signal.
	k_delayed_work_submit(&reboot_work, K_SECONDS(10));

	return 0;
}

static void *firmware_get_buf(uint16_t obj_inst_id, uint16_t res_id, uint16_t res_inst_id, size_t *data_len) {
	static uint8_t firmware_buf[CONFIG_LWM2M_COAP_BLOCK_SIZE];
	*data_len = sizeof(firmware_buf);
	return firmware_buf;
}

static void dfu_target_callback_handler(enum dfu_target_evt_id evt) {
	switch (evt) {
	case DFU_TARGET_EVT_TIMEOUT:
		LOG_INF("dfu_target erase pending");
		break;
	case DFU_TARGET_EVT_ERASE_DONE:
		LOG_INF("dfu_target erase done");
		break;
	default:
		LOG_ERR("dfu_target download error");
	}
}

static int firmware_block_received_cb(uint16_t obj_inst_id, uint16_t res_id, uint16_t res_inst_id,
		uint8_t *data, uint16_t data_len, bool last_block, size_t total_size) {
	if (total_size > FLASH_BANK_SIZE) {
		LOG_ERR("Artifact file size too big: %d", total_size);
		return -EINVAL;
	}

	if (!data_len) {
		LOG_ERR("Data len is zero, nothing to write.");
		return -EINVAL;
	}

	static uint32_t bytes_downloaded;
	static uint8_t percent_downloaded;

	int ret;

	if (bytes_downloaded == 0) {
		int img_type = dfu_target_img_type(data, data_len);
		if (img_type < 0) {
			LOG_ERR("dfu_target_img_type: %d", img_type);
			return img_type;
		}

		const char *img_type_str = "";
		switch (img_type) {
		case DFU_TARGET_IMAGE_TYPE_MCUBOOT:
			img_type_str = " MCUBoot";
			break;
		case DFU_TARGET_IMAGE_TYPE_MODEM_DELTA:
			img_type_str = " modem delta";
			break;
		}
		LOG_INF("Started downloading%s image", img_type_str);

		ret = dfu_target_init(img_type, total_size, dfu_target_callback_handler);
		if (ret) {
			LOG_ERR("dfu_target_init(%d, %d): %d", img_type, total_size, ret);
			return ret;
		}

#ifndef CONFIG_IMG_ERASE_PROGRESSIVELY
		ret = boot_erase_img_bank(FLASH_AREA_IMAGE_SECONDARY);
		if (ret) {
			LOG_ERR("boot_erase_img_bank: %d", ret);
			goto cleanup;
		}
#endif
	}

	bytes_downloaded += data_len;

	uint8_t percent = 100;
	if (total_size) {
		percent = 100 * bytes_downloaded / total_size;
	}
	if (percent_downloaded < percent) {
		percent_downloaded = percent;
		LOG_INF("%d%%", percent_downloaded);
	}

	ret = dfu_target_write(data, data_len);
	if (ret) {
		LOG_ERR("dfu_target_write: %d", ret);
		goto cleanup;
	}

	if (last_block && total_size && bytes_downloaded != total_size) {
		LOG_ERR("Early last block, downloaded %d, expecting %d", bytes_downloaded, total_size);
		ret = -EIO;
		goto cleanup;
	}

	if (last_block) {
		ret = dfu_target_done(true);
		if (ret) {
			LOG_ERR("dfu_target_done(true): %d", ret);
			goto cleanup;
		}
	}

	return 0;

cleanup:
	bytes_downloaded = 0;
	percent_downloaded = 0;

	int done_ret = dfu_target_done(false);
	if (done_ret) {
		LOG_ERR("dfu_target_done(false): %d", done_ret);
	}

	return ret;
}

static int init_lwm2m_resources(fota_client_info client_info) {
	LOG_INF("Firmware version: %s", client_info.firmware_version);
	LOG_INF("Model number:     %s", client_info.model_number);
	LOG_INF("Serial numbera:   %s", client_info.serial_number);
	LOG_INF("Manufacturer:     %s", client_info.manufacturer);

	char *server_url;
	uint16_t server_url_len;
	uint8_t server_url_flags;
	int ret = lwm2m_engine_get_res_data("0/0/0", (void **)&server_url, &server_url_len, &server_url_flags);
	if (ret) {
		LOG_ERR("Error getting LwM2M server URL data: %d", ret);
		return ret;
	}
	snprintk(server_url, server_url_len, "coap://172.16.15.14");

	// Security Mode (3 == NoSec)
	ret = lwm2m_engine_set_u8("0/0/2", 3);
	if (ret) {
		LOG_ERR("Error setting LwM2M security mode: %d", ret);
		return ret;
	}

	// Firmware pull uses the buffer set by the Package resource (5/0/0) pre-write callback
	// for passing downloaded firmware chunks to the firmware write callback.
	lwm2m_engine_register_pre_write_callback("5/0/0", firmware_get_buf);
	lwm2m_firmware_set_write_cb(firmware_block_received_cb);

	k_delayed_work_init(&reboot_work, do_reboot);
	lwm2m_firmware_set_update_cb(firmware_update_cb);

	lwm2m_engine_set_res_data("3/0/0", client_info.manufacturer, strlen(client_info.manufacturer), LWM2M_RES_DATA_FLAG_RO);
	lwm2m_engine_set_res_data("3/0/1", client_info.model_number, strlen(client_info.model_number), LWM2M_RES_DATA_FLAG_RO);
	lwm2m_engine_set_res_data("3/0/2", client_info.serial_number, strlen(client_info.serial_number), LWM2M_RES_DATA_FLAG_RO);
	lwm2m_engine_set_res_data("3/0/3", client_info.firmware_version, strlen(client_info.firmware_version), LWM2M_RES_DATA_FLAG_RO);

	return 0;
}

static int init_image() {
	if (!boot_is_img_confirmed()) {
		int ret = boot_write_img_confirmed();
		if (ret) {
			LOG_ERR("confirm image: %d", ret);
			return ret;
		}

		LOG_INF("Confirmed firmware image.");
	}

	return 0;
}

static char endpoint_name[20];

static int init_endpoint_name() {
	int err = modem_info_init();
	if (err) {
		LOG_ERR("modem_info_init: %d", err);
		return err;
	}

	const int DATA_BUF_SIZE=15;
	char imei[DATA_BUF_SIZE];
	int len = modem_info_string_get(MODEM_INFO_IMEI, imei, DATA_BUF_SIZE);
	if (len <= 0) {
		LOG_ERR("read IMEI: %d", len);
		return len;
	}
	snprintf(endpoint_name, sizeof(endpoint_name), "nrf-%s", imei);

	char fw_version[MODEM_INFO_MAX_RESPONSE_SIZE] = {0};
	len = modem_info_string_get(MODEM_INFO_FW_VERSION, fw_version, MODEM_INFO_MAX_RESPONSE_SIZE);
	if (len <= 0) {
		LOG_ERR("read firmware version: %d", len);
		return len;
	}
	LOG_INF("Modem firmware version: %s", log_strdup(fw_version));

	return 0;
}

int fota_init(fota_client_info client_info) {
	int ret = check_modem_firmware_update();
	if (ret) {
		LOG_ERR("check_modem_firmware_update: %d", ret);
		return ret;
	}
	
	ret = init_lwm2m_resources(client_info);
	if (ret) {
		LOG_ERR("init_lwm2m_resources: %d", ret);
		return ret;
	}

	ret = init_image();
	if (ret) {
		LOG_ERR("init_image: %d", ret);
		return ret;
	}

	ret = init_endpoint_name();
	if (ret) {
		return ret;
	}

	static struct lwm2m_ctx client;

	uint32_t flags = IS_ENABLED(CONFIG_LWM2M_RD_CLIENT_SUPPORT_BOOTSTRAP) ?
				LWM2M_RD_CLIENT_FLAG_BOOTSTRAP : 0;

	lwm2m_rd_client_start(&client, endpoint_name, flags, NULL);

	return 0;
}
```

## src/fota.h
```c
/*
	Copyright [2019] [Exploratory Engineering]
	Modifications Copyright [2021] [Lab5e AS]

   Licensed under the Apache License, Version 2.0 (the "License");
   you may not use this file except in compliance with the License.
   You may obtain a copy of the License at

       http://www.apache.org/licenses/LICENSE-2.0

   Unless required by applicable law or agreed to in writing, software
   distributed under the License is distributed on an "AS IS" BASIS,
   WITHOUT WARRANTIES OR CONDITIONS OF ANY KIND, either express or implied.
   See the License for the specific language governing permissions and
   limitations under the License.#include <zephyr.h>
*/   

#pragma once

// fota_client_info holds info that is reported by the LwM2M client.
// Most fields can have arbitrary data but the firmware_version field
// should match the version of a firmware image uploaded to https://api.nbiot.engineering/.
typedef struct {
	char *manufacturer;
	char *model_number;
	char *serial_number;
	char *firmware_version;
} fota_client_info;

// fota_init assumes that the LTE Link Control subsystem is initialized and a connection established.
// It initializes the Firmware-over-the-Air subsystem, starting the LwM2M client which downloads and installs firmware
// updates, rebooting the device as necessary.
// Call this function after you've initialized your application and done any self-tests to confirm that the system is
// functional after an update; otherwise, reboot the device and it will revert to the the previous confirmed image.
int fota_init(fota_client_info client_info);
```
